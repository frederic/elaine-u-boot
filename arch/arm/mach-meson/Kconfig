## arch/arm/mach-meson/Kconfig
```kconfig
if ARCH_MESON

config MESON64_COMMON
	bool
	select ARM64
	select CLK
	select DM
	select DM_SERIAL
	select SYSCON
	select REGMAP
	select BOARD_LATE_INIT
	imply CMD_DM

config MESON_GX
	bool
	select MESON64_COMMON

choice
	prompt "Platform select"
	default MESON_GXBB

config MESON_GXBB
	bool "GXBB"
	select MESON_GX
	help
	  Select this if your SoC is an S905

config MESON_GXL
	bool "GXL"
	select MESON_GX
	help
	  Select this if your SoC is an S905X/D or S805X

config MESON_GXM
	bool "GXM"
	select MESON_GX
	help
	  Select this if your SoC is an S912

config MESON_AXG
	bool "AXG"
	select MESON64_COMMON
	help
		Select this if your SoC is an A113X/D

config MESON_G12A
	bool "G12A"
	select ARM64
	select DM
	select DM_SERIAL
	help
		Support Amlogic Meson G12A (S905D2/S905X2/S905Y2 etc..)

config MESON_G12B
	bool "Support Amlogic Meson G12B Series SoC"
	select ARM64
	select DM
	select DM_SERIAL
	help
		Support Amlogic Meson G12B (A311D etc..)

endchoice

config AML_BL33_COMPRESS_ENABLE
	bool "Amlogic U-boot compress"
	help
		Support U-boot compress function

config AML_SECURE_BOOT_V3
	bool "Amlogic SecureBoot V3"
	help
		"Support Amlogic SecureBoot V3 version"

config FIP_IMG_SUPPORT
	bool "Amlogic FIP IMG format file"
	help
		"Support Amlogic FIP IMG format"

config AML_SECURE_UBOOT
	bool "Amlogic SecureBoot function"
	help
		"Support Amlogic SecureBoot function"

config AML_CRYPTO_UBOOT
	bool "Encrypt Amlogic U-boot"
	help
		"Support U-boot encrypt function"

config AML_TSENSOR
	bool "Amlogic Temp Sensor"
	help
		"Support Amlogic Thermal Sensor"

config AML_TSENSOR_COOL
	bool "Amlogic HIGH TEMP COOL"
	depends on AML_TSENSOR
	help
		"Support Amlogic High Temperature Cool"

config AML_OSCRING
	bool "Amlogic OSCRING MSR"
	help
		"Support Amlogic chip oscring msr"

if MESON_GXBB

config TARGET_ODROID_C2
	bool "ODROID-C2"
	help
	  ODROID-C2 is a single board computer based on Meson GXBaby
	  with 2 GiB of RAM, Gigabit Ethernet, HDMI, 4 USB, micro-SD
	  slot, eMMC, IR receiver and a 40-pin GPIO header.

endif

if MESON_GXL

config SYS_SOC
	default "gxl"

config TARGET_P212
	bool "P212"
	help
	  P212 is a reference dessign board based on Meson GXL S905X SoC
	  with 2 GiB of RAM, Ethernet, HDMI, 2 USB, micro-SD slot,
	  eMMC, IR receiver, CVBS+Audio jack and a SDIO WiFi module.

config TARGET_LIBRETECH_CC
	bool "LIBRETECH-CC"
	help
	  LibreTech CC is a single board computer based on Meson GXL
	  with 2 GiB of RAM, Ethernet, HDMI, 4 USB, micro-SD slot,
	  eMMC, IR receiver and a 40-pin GPIO header.

config TARGET_KHADAS_VIM
	bool "KHADAS-VIM"
	help
	  Khadas VIM is a single board computer based on Meson GXL
	  with 2 GiB of RAM, Ethernet, HDMI, 4 USB, micro-SD slot,
	  eMMC, IR receiver and a 40-pin GPIO header.

endif

# G12A series boards

if MESON_G12A

config SYS_SOC
	default "g12a"

config TARGET_G12A_U200_V1
	bool "G12A_U200_V1"

config TARGET_G12A_U211_V1
	bool "G12A_U211_V1"

config TARGET_SM1_ELAINE_P1
	bool "SM1_ELAINE_P1"

config TARGET_SM1_ELAINE_P2
	bool "SM1_ELAINE_P2"

config TARGET_SM1_ELAINE_B1
	bool "SM1_ELAINE_B1"

config TARGET_SM1_ELAINE_BX
	bool "SM1_ELAINE_BX"

endif

if MESON_G12B

config SYS_SOC
	default "g12b"

config TARGET_G12B_W400_V1
	bool "G12B_W400_V1"

config TARGET_G12B_NEWMAN_PX
       bool "G12B_NEWMAN_PX"

config TARGET_G12B_NEWMAN_BX
       bool "G12B_NEWMAN_BX"

config TARGET_G12B_PUDDY_PX
       bool "G12B_PUDDY_PX"

endif


config SYS_MALLOC_F_LEN
	default 0x1000

source "board/amlogic/Kconfig"

endif
```

## board/amlogic/g12b_newman_bx/Kconfig
```kconfig
if TARGET_G12B_NEWMAN_BX

config SYS_BOARD
	default "g12b_newman_bx"

config SYS_VENDOR
	default "amlogic"

config SYS_CONFIG_NAME
	default "g12b_newman_bx"

config CONFIG_AML_ANTIROLLBACK
	bool
	default n

config ZIRCON_BOOT_IMAGE
        bool "Zircon boot image support"
        default n

endif
```

## board/amlogic/g12b_newman_px/Kconfig
```kconfig
if TARGET_G12B_NEWMAN_PX

config SYS_BOARD
	default "g12b_newman_px"

config SYS_VENDOR
	default "amlogic"

config SYS_CONFIG_NAME
	default "g12b_newman_px"

config CONFIG_AML_ANTIROLLBACK
	bool
	default n

config G12B_NEWMAN_P2_1
	bool "Additional support for amlogic g12b newman p2.1 board"
	default n

config ZIRCON_BOOT_IMAGE
	bool "Zircon boot image support"
	default n

endif
```

## board/amlogic/g12b_puddy_px/Kconfig
```kconfig
if TARGET_G12B_PUDDY_PX

config SYS_BOARD
	default "g12b_puddy_px"

config SYS_VENDOR
	default "amlogic"

config SYS_CONFIG_NAME
	default "g12b_puddy_px"

config CONFIG_AML_ANTIROLLBACK
	bool
	default n

config ZIRCON_BOOT_IMAGE
        bool "Zircon boot image support"
        default n

endif
```

## board/amlogic/sm1_elaine_b1/Kconfig
```kconfig
if TARGET_SM1_ELAINE_B1

config SYS_SOC
	default "g12a"

config SYS_BOARD
	default "sm1_elaine_b1"

config SYS_VENDOR
	default "amlogic"

config SYS_CONFIG_NAME
	default "sm1_elaine_b1"

endif
```

## board/amlogic/sm1_elaine_bx/Kconfig
```kconfig
if TARGET_SM1_ELAINE_BX

config SYS_SOC
	default "g12a"

config SYS_BOARD
	default "sm1_elaine_bx"

config SYS_VENDOR
	default "amlogic"

config SYS_CONFIG_NAME
	default "sm1_elaine_bx"

endif
```

## board/amlogic/sm1_elaine_p0/Kconfig
```kconfig
if TARGET_SM1_ELAINE_P0

config SYS_SOC
	default "g12a"

config SYS_BOARD
	default "sm1_elaine_p0"

config SYS_VENDOR
	default "amlogic"

config SYS_CONFIG_NAME
	default "sm1_elaine_p0"

endif
```

## board/amlogic/sm1_elaine_p1/Kconfig
```kconfig
if TARGET_SM1_ELAINE_P1

config SYS_SOC
	default "g12a"

config SYS_BOARD
	default "sm1_elaine_p1"

config SYS_VENDOR
	default "amlogic"

config SYS_CONFIG_NAME
	default "sm1_elaine_p1"

endif
```

## cmd/amlogic/Kconfig
```kconfig
config AML_CMD
	bool "Amlogic command"
	default y
	help
	 support amlogic commands

config AML_RPMB_DISABLE
	bool "support RPMB set in bootargs"
	default n
	help
	  Support RPMB set in bootargs.

config AML_STORAGE
	bool "aml storage support"
	help
	  storage cmd support

config AML_IMG_READ
	depends on AML_STORAGE
	bool "image read"
	default y
	help
	  based on AML_STORAGE
	  read image without specify size

config AML_DEFENV
	bool "aml defenv_without"
	default y
	help
	  support reserv env from c array

config CMD_RSVMEM
	bool "rsvmem cmd"
	default y
	help
	  support rsvmem cmd

config CMD_DDR_D2PLL
	bool "d2pll cmd"
	default n
	help
	  support d2pll cmd

config CMD_DDR_TEST
	bool "ddr test cmd"
	default n
	help
	  support ddr_test cmd

config CMD_REBOOT
	bool "CMD_REBOOT"
	depends on MMC_FTS || NAND_FTS
	help
	 CMD_REBOOT support.

config CMD_FACTORY_BOOT
	bool "CMD_FACTORY_BOOT"
	depends on MMC_FTS || NAND_FTS
	help
	 CMD_FACTORY_BOOT support.

config MMC_FTS
	bool "MMC_FTS"
	default y
	help
	 MMC_FTS support.

config NAND_FTS
	bool "NAND_FTS"
	default n
	help
	 NAND_FTS support.

config AML_RPMB_DISABLE
	bool "support RPMB set in bootargs"
	default n
	help
	 Support RPMB set in bootargs.

config CMD_DDR_D2PLL
	bool "d2pll cmd"
	default n
	help
	 support d2pll cmd

config CMD_DDR_TEST
	bool "ddr test cmd"
	default n
	help
	 support ddr_test cmd

config IMG_SECURE_CHECK_SZ
	int "secure boot size limitation"
	default 0
	help
	 Check if boot image size is larger than
	 the secure boot size limitation

config CMD_AVB
    bool "avb operations"
    default n
    help
     support avb operations

config CMD_CVBS
	bool "cvbs command for video"
	depends on CMDLINE && AML_CVBS
	default n
	help
	 support cvbs operations

config CMD_LCD
	bool "lcd command for video"
	depends on CMDLINE && AML_LCD
	default n
	help
	 support lcd operations

config AML_CMD_OSD
	bool "osd command for video"
	depends on CMDLINE && AML_OSD
	default n
	help
	 support osd operations

config CMD_VPU
	bool "vpu command for video"
	depends on CMDLINE && AML_VPU
	default n
	help
	 support vpu operations

config CMD_VPP
	bool "vpp command for video"
	depends on CMDLINE && AML_VPP
	default n
	help
	 support vpp operations

config CMD_VOUT
	bool "output video"
	depends on CMDLINE && AML_VOUT
	default n
	help
	 support vout operations

config CMD_HDMITX
	bool "hdmi sub-system"
	depends on CMDLINE && AML_HDMITX
	default n
	help
	 support hdmi operations

config CMD_TSENSOR
	bool "cpu temp-system"
	default n
	help
	 support temp-system operations

config CMD_OSCRING
	bool "Amlogic measure ring"
	default n
	help
	 for get chip ring info

config CMD_STORAGE
	bool "STORE sub-system"
	default n
	help
	 support store command

config BOOTLOADER_CONTROL_BLOCK
	bool "support bootloader control block"
	default n
	help
	 support bcb avb bootctrl module

config CMD_BOOTCTOL_AVB
	bool "support avb boot"
	depends on BOOTLOADER_CONTROL_BLOCK
	default n
	help
	 support avb operation command

config G_AB_SYSTEM
	bool "support ab boot for bootloader system"
	depends on CMD_BOOTCTOL_AVB
	default n
	help
	 support ab system operation
```

## configs/sm1_elaine_p1_defconfig
```kconfig
CONFIG_ARM=y
CONFIG_ARCH_MESON=y
CONFIG_SYS_TEXT_BASE=0x01000000
CONFIG_MESON_G12A=y
CONFIG_TARGET_SM1_ELAINE_P1=y
CONFIG_DM_GPIO=y
CONFIG_DM_MMC=y
CONFIG_AML_GPT=y
CONFIG_CMD_MMC=y
CONFIG_MMC_MESON_GX=y
# CONFIG_AML_GPIO=y
CONFIG_SYS_PROMPT="sm1_elaine_p1# "
CONFIG_DEFAULT_DEVICE_TREE="meson-g12a-s905d3-elaine-p1"
CONFIG_BOOTCOMMAND="run storeboot"
CONFIG_BOOTDELAY=1
CONFIG_OF_BOARD_SETUP=y
CONFIG_CPU_CLK=1200
# CONFIG_DISPLAY_CPUINFO is not set
# CONFIG_DISPLAY_BOARDINFO is not set
# CONFIG_CMD_BDI is not set
# CONFIG_CMD_IMI is not set
CONFIG_CMD_GPIO=y
# CONFIG_CMD_LOADS is not set
CONFIG_CMD_SPI=n
CONFIG_CMD_SARADC=n
# CONFIG_CMD_SETEXPR is not set
CONFIG_OF_CONTROL=y
CONFIG_ADC=y
CONFIG_SARADC_MESON=y
CONFIG_CLI_ENABLED=y
CONFIG_CLK=y
CONFIG_CLK_MESON=y
CONFIG_CLK_MESON_G12=y
CONFIG_PINCTRL=y
CONFIG_PINCONF=y
CONFIG_PINCTRL_MESON_G12A=y
CONFIG_DM_REGULATOR=y
CONFIG_DM_PWM=y
CONFIG_PWM_MESON=y
CONFIG_ADC_POWER_KEY_CHAN=2
CONFIG_ADC_POWER_KEY_VAL=0
CONFIG_WDT=y
CONFIG_WDT_MESON=y
CONFIG_CMD_WATCHDOG=n
CONFIG_DM_I2C=y
CONFIG_SYS_I2C_MESON=y
CONFIG_CMD_I2C=n
# CONFIG_AML_BL33_COMPRESS_ENABLE=1
CONFIG_AML_CRYPTO_UBOOT=y
CONFIG_AML_CUSTOMER_ID=0
CONFIG_AML_DRIVER=y
CONFIG_AML_MEDIA=y
CONFIG_AML_VPU=y
CONFIG_AML_VPP=y
CONFIG_AML_CANVAS=y
CONFIG_AML_OSD=y
CONFIG_CMD_BMP=y
CONFIG_AML_VOUT=y
CONFIG_AML_CVBS=n
CONFIG_AML_HDMITX=n
CONFIG_AML_LCD=y
CONFIG_AML_LCD_TV=y
CONFIG_AML_LCD_TABLET=y
CONFIG_AML_LCD_EXTERN=y
CONFIG_AML_BL_EXTERN=y
CONFIG_NEED_BL301=y
CONFIG_NEED_BL32=y
CONFIG_FIP_IMG_SUPPORT=y
CONFIG_SYS_LONGHELP=y
CONFIG_CMD_MISC=n
CONFIG_CMD_ITEST=y
CONFIG_CMD_CPU_TEMP=y
CONFIG_CMD_LOADB=n
# CONFIG_AML_MESON=1
# CONFIG_AML_MESON_G12A=1
# CONFIG_AML_MESON_GX=1
# CONFIG_AML_MTD=y
# CONFIG_AML_NAND=y
CONFIG_AML_STORAGE=y
# CONFIG_AML_PARTITION=y
CONFIG_AML_SECURE_BOOT_V3=y
CONFIG_AML_SECURE_UBOOT=y
CONFIG_AML_SECURITY_KEY=y
CONFIG_IMG_SECURE_CHECK_SZ=66060288
CONFIG_ANDROID_IMG=y
CONFIG_BL2_COPY_NUM=4
CONFIG_BOOTLOADER_CONTROL_BLOCK=y
CONFIG_CMD_BOOTCTOL_AVB=y
CONFIG_G_AB_SYSTEM=y
CONFIG_BT_WAKEUP=y
#CONFIG_CEC_OSD_NAME="AML_TV"
CONFIG_CEC_WAKEUP=n
CONFIG_CMD_AML_MTEST=1
CONFIG_CMD_DDR_D2PLL=n
CONFIG_CMD_DDR_TEST=n
CONFIG_CMD_VIU_PROBE=1
CONFIG_CPU_CLK=1200
CONFIG_DDR4_TIMING_TEST=0
CONFIG_DDR_FULL_TEST=0
CONFIG_DDR_LOW_POWER=0
CONFIG_DDR_PLL_BYPASS=0
# CONFIG_DDR_SIZE=0
CONFIG_DDR_USE_EXT_VREF=0
CONFIG_DDR_ZQ_PD=0
CONFIG_DISCRETE_BOOTLOADER=y
CONFIG_EFUSE=y
CONFIG_MDUMP_COMPRESS=1
# CONFIG_PLATFORM_POWER_INIT=y
CONFIG_POWER_KEY_NOT_SUPPORTED_FOR_BURN=y
CONFIG_RANDOM_ETHADDR=1
CONFIG_SARADC_CH=2
CONFIG_STORE_COMPATIBLE=y
CONFIG_SYS_HUSH_PARSER=y
CONFIG_SYS_NO_FLASH=y
CONFIG_TPL_COPY_NUM=4
CONFIG_TPL_PART_NAME="tpl"
CONFIG_TPL_SIZE_PER_COPY=0x200000
CONFIG_TXLX_USB=y
CONFIG_USB_DEVICE_V2=y
CONFIG_USB=y
CONFIG_CMD_USB=y
CONFIG_USB_STORAGE=y
CONFIG_USB_XHCI_HCD=y
CONFIG_USB_XHCI_DWC3=y
CONFIG_FASTBOOT=y
CONFIG_CMD_FASTBOOT=n
CONFIG_FASTBOOT_DWC_PCD=y
CONFIG_USB_GADGET=y
CONFIG_USB_GADGET_DUALSPEED=y
CONFIG_UNIFY_KEY_MANAGE=y
CONFIG_SECURE_STORAGE=y
CONFIG_VCCK_INIT_VOLTAGE=800
# CONFIG_VDDEE_INIT_VOLTAGE=800
# CONFIG_VDDEE_SLEEP_VOLTAGE=731
CONFIG_DEBUG_UART=y
CONFIG_DEBUG_UART_MESON=y
CONFIG_DEBUG_UART_BASE=0xff803000
CONFIG_DEBUG_UART_CLOCK=24000000
CONFIG_DEBUG_UART_ANNOUNCE=y
CONFIG_DEBUG_UART_SKIP_INIT=y
CONFIG_MESON_SERIAL=y
CONFIG_OF_LIBFDT_OVERLAY=y
CONFIG_CMD_D2PLL=n
CONFIG_CMD_DDRTEST=n
#CONFIG_MTD_UBI=y
#CONFIG_MTD=y
#CONFIG_NAND=y
#CONFIG_MTD_DEVICE=y
#CONFIG_CMD_MTDPARTS=y
#CONFIG_AML_MTDPART=y
#CONFIG_MTD_PARTITIONS=y
CONFIG_DM=y
CONFIG_SPI=y
CONFIG_DM_SPI=y
CONFIG_AML_SPICC=y
CONFIG_PHY=y
CONFIG_DM_USB=y
CONFIG_AML_USB2_PHY=y
CONFIG_AML_USB3_PHY=y
CONFIG_AML_USB=y
CONFIG_DM_ETH=y
#CONFIG_SPI_FLASH=y
CONFIG_DM_SPI_FLASH=y
CONFIG_CMD_SF=n
CONFIG_AML_SPIFC=y
CONFIG_SPI_FLASH_WINBOND=y
#CONFIG_SPI_FLASH_MTD=y
#CONFIG_SPI_NAND=y
CONFIG_CMD_RSVMEM=n
CONFIG_CMD_REBOOT=y
CONFIG_CMD_FACTORY_BOOT=y
CONFIG_MMC_FTS=y
CONFIG_AML_TSENSOR=y
CONFIG_AML_TSENSOR_COOL=y
# CONFIG_AML_OSCRING=y
#CONFIG_CMD_DDR_D2PLL=y
CONFIG_CMD_DDR_TEST=y
CONFIG_NOT_DTS_CONTROL_BL=y
CONFIG_CMD_BOOTD=n
CONFIG_CMD_BOOTI=n
CONFIG_CMD_NET=n
CONFIG_CMD_ELF=n
CONFIG_CMD_MEMORY=n
CONFIG_CMD_CONSOLE=n
CONFIG_CMD_DM=n
CONFIG_CMD_EDITENV=n
CONFIG_CMD_FLASH=n
CONFIG_CMD_GO=n
CONFIG_CMD_UNZIP=n
CONFIG_CMD_XIMG=n
CONFIG_CMD_LZMADEC=n
CONFIG_AML_RPMB_DISABLE=y
CONFIG_CMD_SOURCE=n
CONFIG_CMD_BOOTEFI=y
CONFIG_CMD_PXE=n
CONFIG_CMD_EXT2=n
CONFIG_CMD_FS_GENERIC=n
CONFIG_CMD_PART=n
CONFIG_AML_CMD_OSD=y
CONFIG_CMD_VOUT=y
CONFIG_CMD_STORAGE=y
CONFIG_ANDROID_BOOT_IMAGE=y
CONFIG_LIBAVB=y
CONFIG_AML_LCD_EXTERN_MIPI_P070ACB=y
CONFIG_AML_REMOVE_BOOTLOADER_PARTITION=y
CONFIG_LOGLEVEL=6
```

## drivers/amlogic/media/common/Kconfig
```kconfig
source "drivers/amlogic/media/common/vpu/Kconfig"
source "drivers/amlogic/media/common/vpp/Kconfig"
```

## drivers/amlogic/media/common/vpp/Kconfig
```kconfig
config AML_VPP
	bool "AML VPP drivers Support"
	help
	  Enable support for the Amlogic VPP drivers.
```
